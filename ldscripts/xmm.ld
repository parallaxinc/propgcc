MEMORY {
  hub     : ORIGIN = 0x00000000, LENGTH = 32K
  ram     : ORIGIN = 0x20000000, LENGTH = 256M
  rom     : ORIGIN = 0x30000000, LENGTH = 256M
}

REGION_ALIAS("REGION_TEXT", rom);
REGION_ALIAS("REGION_DATA", ram);
REGION_ALIAS("REGION_HEAP", ram);

INCLUDE propeller_xmm.ld